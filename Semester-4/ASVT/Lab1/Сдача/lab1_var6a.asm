;============================================================
; Лабораторная работа 1 - Вариант 6а
; Основы работы в среде Atmel Studio
; Архитектура и система команд МК ATmega32
;============================================================

.def TMP = R20

.org $000
    JMP reset            ; Указатель на начало программы

;------------------------------------------------------------
; Функция паузы (задержка 10 мс при частоте 8 МГц)
; Вариант 6а: INC + NOP + BRNE (внутр.), NOP + INC + BRNE (внешн.)
; x = 28 (R29), y = 178 (R30), 1 NOP перед RET
; Общее число тактов: 80000
; Время: 80000 / 8000000 = 0.01 с = 10 мс
;------------------------------------------------------------
delay:
    LDI R30, 178         ; y = 178
    LDI R29, 28          ; x = 28
delay_sub:
    INC R29              ; R29 = R29 + 1
    NOP                  ; пустая команда (1 такт)
    BRNE delay_sub       ; если R29 != 0, переход к delay_sub
    NOP                  ; пустая команда (1 такт)
    INC R30              ; R30 = R30 + 1
    BRNE delay_sub       ; если R30 != 0, переход к delay_sub
    NOP                  ; дополнительный NOP для точной задержки
    RET                  ; возврат из подпрограммы

;------------------------------------------------------------
; Начальная настройка
;------------------------------------------------------------
reset:
; настройка исходных значений
    LDI TMP, 0x01        ; загрузка начального значения
    MOV R0, TMP          ; R0 = 0x01 (бегущая единица)
    CLR TMP              ; TMP = 0x00
    MOV R1, TMP          ; R1 = 0x00
    MOV R2, TMP          ; R2 = 0x00
    MOV R3, TMP          ; R3 = 0x00

; настройка портов ввода-вывода
    SER TMP              ; TMP = 0xFF
    OUT DDRA, TMP        ; Порт A - выход
    OUT DDRB, TMP        ; Порт B - выход
    OUT DDRC, TMP        ; Порт C - выход
    OUT DDRD, TMP        ; Порт D - выход

; Установка вершины стека в конец ОЗУ
    LDI TMP, HIGH(RAMEND) ; Старшие разряды адреса
    OUT SPH, TMP
    LDI TMP, LOW(RAMEND)  ; Младшие разряды адреса
    OUT SPL, TMP

;------------------------------------------------------------
; Основной цикл
;------------------------------------------------------------
loop:
; Циклический сдвиг 32-разрядного числа R0-R3
    BST R0, 0            ; сохранение младшего бита во флаге T
    LSR R3               ; логический сдвиг вправо
    ROR R2               ; циклический сдвиг вправо
    ROR R1               ; циклический сдвиг вправо
    ROR R0               ; циклический сдвиг вправо
    BLD R3, 7            ; заполнение 7 бита значением из флага T

; Вывод 32-разрядного числа R0-R3 на порты PORTA-PORTD
    OUT PORTA, R0        ; вывод младшего байта в порт A
    OUT PORTB, R1        ; вывод в порт B
    OUT PORTC, R2        ; вывод в порт C
    OUT PORTD, R3        ; вывод в порт D

; Пауза
    CALL delay           ; вызов подпрограммы задержки

; Возврат в начало основного цикла
    RJMP loop            ; безусловный переход к loop

;------------------------------------------------------------
; Задание п.9: декодированные машинные слова
; 0x9468 -> SET        (установка флага пересылки T)
; 0xf3e1 -> BREQ -4   (переход если Z=1, смещение -4)
;------------------------------------------------------------
task9_label:
    NOP                  ; заполнение для корректного смещения
    NOP                  ; заполнение для корректного смещения
    SET                  ; 0x9468: BSET 6 (SET)
    BREQ task9_label     ; 0xf3e1: BRBS 1, -4 (BREQ -4)
